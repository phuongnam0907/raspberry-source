## rpi-build/conf/bblayers.conf
```bitbake
# POKY_BBLAYERS_CONF_VERSION is increased each time build/conf/bblayers.conf
# changes incompatibly

BBPATH = "${TOPDIR}"
BSPDIR := "${@os.path.abspath(os.path.dirname(d.getVar('FILE', True)) + '/../..')}"

BBFILES ?= ""

BBLAYERS ?= " \
  ${BSPDIR}/sources/poky/meta \
  ${BSPDIR}/sources/poky/meta-poky \
  ${BSPDIR}/sources/poky/meta-yocto-bsp \
  \
  "
BBLAYERS += " ${BSPDIR}/sources/meta-openembedded/meta-oe "
BBLAYERS += " ${BSPDIR}/sources/meta-openembedded/meta-networking "
BBLAYERS += " ${BSPDIR}/sources/meta-openembedded/meta-python "
BBLAYERS += " ${BSPDIR}/sources/meta-openembedded/meta-multimedia "
BBLAYERS += " ${BSPDIR}/sources/meta-raspberrypi "
BBLAYERS += " ${BSPDIR}/sources/meta-qt5 "
BBLAYERS += " ${BSPDIR}/sources/meta-rpi3 "
```

## rpi-build/conf/local.conf
```bitbake
MACHINE ??= 'rasp3'
DISTRO ?= 'x11'
PACKAGE_CLASSES ?= 'package_rpm'
EXTRA_IMAGE_FEATURES ?= "debug-tweaks"
USER_CLASSES ?= "buildstats image-mklibs image-prelink"
PATCHRESOLVE = "noop"
BB_DISKMON_DIRS ??= "\
    STOPTASKS,${TMPDIR},1G,100K \
    STOPTASKS,${DL_DIR},1G,100K \
    STOPTASKS,${SSTATE_DIR},1G,100K \
    STOPTASKS,/tmp,100M,100K \
    ABORT,${TMPDIR},100M,1K \
    ABORT,${DL_DIR},100M,1K \
    ABORT,${SSTATE_DIR},100M,1K \
    ABORT,/tmp,10M,1K"
PACKAGECONFIG_append_pn-qemu-system-native = " sdl"
PACKAGECONFIG_append_pn-nativesdk-qemu = " sdl"
CONF_VERSION = "1"

ENABLE_UART = "1"
ENABLE_I2C = "1"
ENABLE_SPI_BUS = "1"

DISTRO_FEATURES = "x11"

LICENSE_FLAGS_WHITELIST_append = " commercial_faad2 commercial_gstreamer1.0-plugins-ugly "
KERNEL_VERSION_SANITY_SKIP="1"

SDIMG_ROOTFS_TYPE = "ext3.xz"
DL_DIR ?= "${BSPDIR}/downloads/"
ACCEPT_FSL_EULA = "1"

INHERIT += "externalsrc"
EXTERNALSRC_pn-linux-raspberrypi = "/home/lenam-styl084/rpi3/outsource/linux"
EXTERNALSRC_BUILD_pn-linux-raspberrypi = "/home/lenam-styl084/rpi3/outsource/linux"

RPI_EXTRA_CONFIG = " \n\
# Raspberry Pi Device Tree Overlays \n\
dtoverlay=rpi-led-gpio \n\
dtoverlay=gpio-led-seg \n\
dtoverlay=rpi-pcd8544 \n\
dtoverlay=i2c-pca \n\
dtoverlay=rpi-srf05 \n\
# Raspberry Deug Turn On \n\
dtdebug=on \n\
"
```
